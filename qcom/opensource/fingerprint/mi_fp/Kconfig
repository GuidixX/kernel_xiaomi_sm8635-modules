## qcom/opensource/fingerprint/mi_fp/Kconfig
```kconfig
config FINGERPRINT_MI_FP
	tristate "Finger print card mi_fp"
	default n
	help
	  Say Y here to enable support for mi_fp fingerprint driver.
	  If unsure, say N.
	  To compile this driver as a module, choose M here.

config FP_HAVE_MULTI_SCREEN
	bool "Have multi screen"
	default n
	help
	  Enable register two screen in driver

config SIDE_FINGERPRINT
	bool "Side fingerprint"
	default n
	help
	  Side fingerprint configuration

config FINGERPRINT_FP_VREG_CONTROL
	bool "fingerprint fp_vdd_reg regulator control"
	default n
	help
	  Say Y here to enable fp_vdd_vreg regulator by device driver
```

## xiaomi/drivers/char/Kconfig
```kconfig
# SPDX-License-Identifier: GPL-2.0

menu "Xiaomi character devices"

config XLOGCHAR
	tristate "Xiaomi xlogchar driver"
	help
	  Enable Xiaomi xlog character device support.
	  Build as a module (m) to produce xlogchar.ko for DLKM packaging.

endmenu
```

## xiaomi/drivers/input/misc/Kconfig
```kconfig
# SPDX-License-Identifier: GPL-2.0-only

source "drivers/input/misc/aw86927_haptic/Kconfig"
```

## xiaomi/drivers/regulator/Kconfig
```kconfig
# SPDX-License-Identifier: GPL-2.0-only

menu "Xiaomi regulator drivers"

config REGULATOR_WL2866D
	tristate "WL2866D regulator support"
	depends on I2C
	default n
	help
	  Enable support for the WL2866D regulator used by Xiaomi boards.

endmenu
```

## xiaomi/drivers/thermal/Kconfig
```kconfig
# SPDX-License-Identifier: GPL-2.0-only

source "drivers/thermal/xiaomi/Kconfig"
```
